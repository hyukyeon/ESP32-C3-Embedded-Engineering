## examples/02_uart_jtag/sdkconfig.defaults
```kconfig
# Route both stdin and stdout through the built-in USB-Serial/JTAG CDC port.
# Without this, stdin defaults to UART0 (GPIO20) while idf.py monitor sends
# keystrokes over USB CDC → getchar() never sees the input.
CONFIG_ESP_CONSOLE_USB_SERIAL_JTAG=y
```

## examples/21_core_dump/sdkconfig.defaults
```kconfig
# Core Dump 활성화 설정
CONFIG_ESP_COREDUMP_ENABLE_TO_FLASH=y
CONFIG_ESP_COREDUMP_DATA_FORMAT_ELF=y
CONFIG_ESP_COREDUMP_CHECKSUM_CRC32=y

# 커스텀 파티션 테이블
CONFIG_PARTITION_TABLE_CUSTOM=y
CONFIG_PARTITION_TABLE_CUSTOM_FILENAME="partitions.csv"

# Flash 크기 (coredump 파티션 포함 시 4MB 필요)
CONFIG_ESPTOOLPY_FLASHSIZE_4MB=y
CONFIG_ESPTOOLPY_FLASHSIZE="4MB"
```
